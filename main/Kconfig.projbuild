## main/Kconfig.projbuild
```kconfig
menu "Example Configuration"

    menu "Display"
        config EXAMPLE_LCD_RGB_BOUNCE_BUFFER_HEIGHT
            int "RGB Bounce buffer height"
            default 10
            help
                Height of bounce buffer. The width of the buffer is the same as that of the LCD.

        config EXAMPLE_LVGL_PORT_TASK_MAX_DELAY_MS
            int "LVGL timer task maximum delay (ms)"
            default 500
            range 2 2000  # Example range, adjust as needed
            help
            The maximum delay of the LVGL timer task, in milliseconds.

        config EXAMPLE_LVGL_PORT_TASK_MIN_DELAY_MS
            int "LVGL timer task minimum delay (ms)"
            default 10
            range 1 100  # Example range, adjust as needed
            help
            The minimum delay of the LVGL timer task, in milliseconds.

        config EXAMPLE_LVGL_PORT_TASK_PRIORITY
            int "LVGL task priority"
            default 2
            help
                The Board Support Package will create a task that will periodically handle LVGL operation in lv_timer_handler().

        config EXAMPLE_LVGL_PORT_TASK_STACK_SIZE_KB
            int "LVGL task stack size (KB)"
            default 8
            help
                Size(KB) of LVGL task stack.

        config EXAMPLE_LVGL_PORT_TASK_CORE
            int "LVGL timer task core"
            default -1
            range -1 1
            help
            The core of the LVGL timer task.
            Set to -1 to not specify the core.
            Set to 1 only if the SoCs support dual-core, otherwise set to -1 or 0.

        config EXAMPLE_LVGL_PORT_TICK
            int "LVGL tick period"
            default 2
            range 1 100
            help
                Period of LVGL tick timer.

        config EXAMPLE_LVGL_PORT_AVOID_TEAR_ENABLE
            bool "Avoid tearing effect"
            default "n"
            help
                Avoid tearing effect through LVGL buffer mode and double frame buffers of RGB LCD. This feature is only available for RGB LCD.

        choice
            depends on EXAMPLE_LVGL_PORT_AVOID_TEAR_ENABLE
            prompt "Select Avoid Tearing Mode"
            default EXAMPLE_LVGL_PORT_AVOID_TEAR_MODE_3
            config EXAMPLE_LVGL_PORT_AVOID_TEAR_MODE_1
                bool "Mode1: LCD double-buffer & LVGL full-refresh"
            config EXAMPLE_LVGL_PORT_AVOID_TEAR_MODE_2
                bool "Mode2: LCD triple-buffer & LVGL full-refresh"
            config EXAMPLE_LVGL_PORT_AVOID_TEAR_MODE_3
                bool "Mode3: LCD double-buffer & LVGL direct-mode"
            help
                The current tearing prevention mode supports both full refresh mode and direct mode. Tearing prevention mode may consume more PSRAM space
        endchoice

        config EXAMPLE_LVGL_PORT_AVOID_TEAR_MODE
            depends on EXAMPLE_LVGL_PORT_AVOID_TEAR_ENABLE
            int
            default 1 if EXAMPLE_LVGL_PORT_AVOID_TEAR_MODE_1
            default 2 if EXAMPLE_LVGL_PORT_AVOID_TEAR_MODE_2
            default 3 if EXAMPLE_LVGL_PORT_AVOID_TEAR_MODE_3

        choice
            depends on EXAMPLE_LVGL_PORT_AVOID_TEAR_ENABLE
            prompt "Select rotation"
            default EXAMPLE_LVGL_PORT_ROTATION_0
            config EXAMPLE_LVGL_PORT_ROTATION_0
                bool "Rotation 0"
            config EXAMPLE_LVGL_PORT_ROTATION_90
                bool "Rotation 90"
            config EXAMPLE_LVGL_PORT_ROTATION_180
                bool "Rotation 180"
            config EXAMPLE_LVGL_PORT_ROTATION_270
                bool "Rotation 270"
        endchoice

        config EXAMPLE_LVGL_PORT_ROTATION_DEGREE
            int
            default 0 if EXAMPLE_LVGL_PORT_ROTATION_0
            default 90 if EXAMPLE_LVGL_PORT_ROTATION_90
            default 180 if EXAMPLE_LVGL_PORT_ROTATION_180
            default 270 if EXAMPLE_LVGL_PORT_ROTATION_270

        choice
            depends on !EXAMPLE_LVGL_PORT_AVOID_TEAR_ENABLE
            prompt "Select LVGL buffer memory capability"
            default EXAMPLE_LVGL_PORT_BUF_INTERNAL
            config EXAMPLE_LVGL_PORT_BUF_PSRAM
                bool "PSRAM memory"
            config EXAMPLE_LVGL_PORT_BUF_INTERNAL
                bool "Internal memory"
        endchoice

        config EXAMPLE_LVGL_PORT_BUF_HEIGHT
            depends on !EXAMPLE_LVGL_PORT_AVOID_TEAR_ENABLE
            int "LVGL buffer height"
            default 100
            help
                Height of LVGL buffer. The width of the buffer is the same as that of the LCD.
    endmenu

    menu "Secure Lockbox Integration"
        config LOCKBOX_INTEGRATION_ENABLE
            bool "Enable Secure Lockbox integration architecture"
            default y
            help
                Enables the integration module layout used for Secure Lockbox
                backend bring-up (comm/devices/services/app).

        config LOCKBOX_INTEGRATION_USE_MOCK_DEVICES
            bool "Use mock device behavior for integration modules"
            default y
            depends on LOCKBOX_INTEGRATION_ENABLE
            help
                Keeps integration modules in non-hardware mock mode until
                feature bring-up is complete.

        config LOCKBOX_FEATURE_SC16IS752
            bool "Enable SC16IS752 transport path"
            default n
            depends on LOCKBOX_INTEGRATION_ENABLE

        config LOCKBOX_FEATURE_R503
            bool "Enable R503 fingerprint feature"
            default n
            depends on LOCKBOX_FEATURE_SC16IS752

        config LOCKBOX_FEATURE_HLK_TX510
            bool "Enable HLK-TX510 face recognition feature"
            default n
            depends on LOCKBOX_FEATURE_SC16IS752

        config LOCKBOX_FEATURE_PCA9685
            bool "Enable PCA9685 lock servo driver"
            default n
            depends on LOCKBOX_INTEGRATION_ENABLE

        config LOCKBOX_FEATURE_STATUS_INPUTS
            bool "Enable lockbox status input signals"
            default y
            depends on LOCKBOX_INTEGRATION_ENABLE

        config LOCKBOX_FEATURE_DS3231
            bool "Enable DS3231 RTC (Real-Time Clock)"
            default n
            depends on LOCKBOX_INTEGRATION_ENABLE
            help
                Enables the DS3231 I2C RTC for persistent date/time storage.
                Used to capture real dates (via INTCN) on user authentication.
                Also allows admin to set the RTC date manually.

        config LOCKBOX_FEATURE_INA219
           bool "Enable INA219 power monitoring"
           default n
           depends on LOCKBOX_INTEGRATION_ENABLE

        config LOCKBOX_FEATURE_SLEEP_MODE
            bool "Enable sleep mode"
            default n
            depends on LOCKBOX_FEATURE_STATUS_INPUTS
            help
                Enables sleep mode functionality. When idle conditions
                are met (lid closed, user logged out, face stowed,
                lock engaged), the system enters deep sleep after a
                60-second countdown to conserve battery power.
                Wake via fingerprint touch.

        config LOCKBOX_SLEEP_INACTIVITY_TIMEOUT_S
            int "Inactivity timeout before sleep countdown (seconds)"
            default 300
            range 60 3600
            depends on LOCKBOX_FEATURE_SLEEP_MODE
            help
                Seconds of inactivity before sleep countdown begins.
    endmenu
endmenu
```
